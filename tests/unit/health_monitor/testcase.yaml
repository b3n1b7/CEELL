## tests/unit/health_monitor/testcase.yaml
```yaml
tests:
  ceell.health_monitor:
    platform_allow:
      - native_sim
      - native_sim/native/64
    tags: redundancy unit
```

## tests/unit/msg_deadline/testcase.yaml
```yaml
tests:
  ceell.safety.msg_deadline:
    platform_allow:
      - native_sim
      - native_sim/native/64
    tags: safety unit
```

## tests/unit/msg_redundancy/testcase.yaml
```yaml
tests:
  ceell.msg_redundancy:
    platform_allow:
      - native_sim
      - native_sim/native/64
    tags: redundancy unit
```

## tests/unit/safe_state/testcase.yaml
```yaml
tests:
  ceell.safe_state:
    platform_allow:
      - native_sim
      - native_sim/native/64
    tags: redundancy unit
```

## tests/unit/tsn/testcase.yaml
```yaml
tests:
  ceell.tsn:
    platform_allow:
      - native_sim
      - native_sim/native/64
    tags: tsn network unit
```
